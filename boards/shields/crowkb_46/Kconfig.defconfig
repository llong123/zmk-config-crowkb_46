## boards/shields/crowkb_46/Kconfig.defconfig
```kconfig
if SHIELD_CROWKB_46_LEFT

config ZMK_KEYBOARD_NAME
    default "crowkb_46"

config ZMK_SPLIT_ROLE_CENTRAL
    default y

endif

if SHIELD_CROWKB_46_LEFT || SHIELD_CROWKB_46_RIGHT

config ZMK_SPLIT
    default y

endif
```

## config/boards/shields/crowkb_46/Kconfig.shield
```kconfig
config SHIELD_CROWKB_46_LEFT
    def_bool $(shields_list_contains, crowkb_46_left)

config SHIELD_CROWKB_46_RIGHT
    def_bool $(shields_list_contains, crowkb_46_right)
```
